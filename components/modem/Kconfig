## components/modem/Kconfig
```kconfig
menu "ESP-MODEM"

    config EXAMPLE_COMPONENT_MODEM_APN
        string "Set Access Point Name (APN)"
        default "ntnet"
        help
            Logical name which is used to select the GGSN or the external packet data network.

endmenu
```

## sdkconfig.defaults
```kconfig
#eth
CONFIG_ESP_NETIF_TCPIP_ADAPTER_COMPATIBLE_LAYER=y
#
# Ethernet
#
CONFIG_GPIO_RANGE_MIN=0
CONFIG_GPIO_RANGE_MAX=33
CONFIG_ETH_MDC_GPIO=23
CONFIG_ETH_MDIO_GPIO=18
CONFIG_ETH_PHY_RST_GPIO=5
CONFIG_ETH_PHY_ADDR=0
# end of Ethernet
# end of Rathi ETH 2 GSM project specific config.


#napt
CONFIG_LWIP_PPP_SUPPORT=y
CONFIG_LWIP_PPP_PAP_SUPPORT=y
CONFIG_LWIP_TCPIP_TASK_STACK_SIZE=4096
CONFIG_LWIP_PPP_ENABLE_IPV6=y
CONFIG_UART_ISR_IN_IRAM=y
# Enable NAPT
CONFIG_LWIP_IP_FORWARD=y
CONFIG_LWIP_IPV4_NAPT=y
CONFIG_LWIP_STATS=y
CONFIG_LWIP_IPV6_AUTOCONFIG=y
CONFIG_LWIP_PPP_DEBUG_ON=y

CONFIG_LWIP_DEBUG=y
CONFIG_LWIP_NETIF_DEBUG=y
CONFIG_LWIP_PBUF_DEBUG=n
CONFIG_LWIP_ETHARP_DEBUG=n
CONFIG_LWIP_API_LIB_DEBUG=y
CONFIG_LWIP_SOCKETS_DEBUG=n
CONFIG_LWIP_IP_DEBUG=n
CONFIG_LWIP_ICMP_DEBUG=n
CONFIG_LWIP_DHCP_STATE_DEBUG=y
CONFIG_LWIP_DHCP_DEBUG=y
CONFIG_LWIP_IP6_DEBUG=n
CONFIG_LWIP_ICMP6_DEBUG=n
CONFIG_LWIP_TCP_DEBUG=n

	#	
# Log output	
#	
# CONFIG_LOG_DEFAULT_LEVEL_NONE is not set	
# CONFIG_LOG_DEFAULT_LEVEL_ERROR is not set	
# CONFIG_LOG_DEFAULT_LEVEL_WARN is not set	
CONFIG_LOG_DEFAULT_LEVEL_INFO=y	
# CONFIG_LOG_DEFAULT_LEVEL_DEBUG is not set	
# CONFIG_LOG_DEFAULT_LEVEL_VERBOSE is not set	
CONFIG_LOG_DEFAULT_LEVEL=3	
CONFIG_LOG_COLORS=y	
CONFIG_LOG_TIMESTAMP_SOURCE_RTOS=y	
# CONFIG_LOG_TIMESTAMP_SOURCE_SYSTEM is not set	
# end of Log output


  
# Override some defaults to enable PPP
CONFIG_LWIP_PPP_NOTIFY_PHASE_SUPPORT=y
```

## src/Kconfig.projbuild
```kconfig
menu "Rathi ETH 2 GSM project specific config."
menu "Wifi config"

    menu "Example Configuration"

        config ESP_WIFI_SSID
            string "WiFi SSID"
            default "aayush777_2.4"
            help
                SSID (network name) for the example to connect to.
    
        config ESP_WIFI_PASSWORD
            string "WiFi Password"
            default "CLEB12F512"
            help
                WiFi password (WPA or WPA2) for the example to use.
    
        config ESP_MAXIMUM_RETRY
            int "Maximum retry"
            default 5
            help
                Set the Maximum retry to avoid station reconnecting to the AP unlimited when the AP is really inexistent.
    
        choice ESP_WIFI_SCAN_AUTH_MODE_THRESHOLD
            prompt "WiFi Scan auth mode threshold"
            default ESP_WIFI_AUTH_OPEN
            help
                The weakest authmode to accept in the scan mode.
    
            config ESP_WIFI_AUTH_OPEN
                bool "OPEN"
            config ESP_WIFI_AUTH_WEP
                bool "WEP"
            config ESP_WIFI_AUTH_WPA_PSK
                bool "WPA PSK"
            config ESP_WIFI_AUTH_WPA2_PSK
                bool "WPA2 PSK"
            config ESP_WIFI_AUTH_WPA_WPA2_PSK
                bool "WPA/WPA2 PSK"
            config ESP_WIFI_AUTH_WPA3_PSK
                bool "WPA3 PSK"
            config ESP_WIFI_AUTH_WPA2_WPA3_PSK
                bool "WPA2/WPA3 PSK"
            config ESP_WIFI_AUTH_WAPI_PSK
                bool "WAPI PSK"
        endchoice
    
    endmenu
        endmenu



        menu "Ethernet"

            config GPIO_RANGE_MIN
                int
                default 0
        
            config GPIO_RANGE_MAX
                int
                default 33
        
            config ETH_MDC_GPIO
                    int "SMI MDC GPIO number"
                    range GPIO_RANGE_MIN GPIO_RANGE_MAX
                    default 23
                    help
                        Set the GPIO number used by SMI MDC.
        
            config ETH_MDIO_GPIO
                    int "SMI MDIO GPIO number"
                    range GPIO_RANGE_MIN GPIO_RANGE_MAX
                    default 18
                    help
                        Set the GPIO number used by SMI MDIO.
        
            config ETH_PHY_RST_GPIO
                    int "PHY Reset GPIO number"
                    range -1 GPIO_RANGE_MAX
                    default 5
                    help
                        Set the GPIO number used to reset PHY chip.
                        Set to -1 to disable PHY chip hardware reset.
        
            config ETH_PHY_ADDR
                    int "PHY Address"
                    range 0 31
                    default 1
                    help
                        Set PHY address according your board schematic.
               
        endmenu
        menu "GSM Config"

            choice EXAMPLE_MODEM_DEVICE
                prompt "Choose supported modem device (DCE)"
                default EXAMPLE_MODEM_DEVICE_BG96
                help
                    Select modem device connected to the ESP DTE.
                config EXAMPLE_MODEM_DEVICE_SIM800
                    bool "SIM800"
                    help
                        SIMCom SIM800L is a GSM/GPRS module.
                        It supports Quad-band 850/900/1800/1900MHz.
                config EXAMPLE_MODEM_DEVICE_BG96
                    bool "BG96"
                    help
                        Quectel BG96 is a series of LTE Cat M1/Cat NB1/EGPRS module.
                config EXAMPLE_MODEM_DEVICE_SIM7600
                    bool "SIM7600"
                    help
                        SIM7600 is Multi-Band LTE-TDD/LTE-FDD/HSPA+ and GSM/GPRS/EDGE module
            endchoice
        
            config EXAMPLE_MODEM_PPP_AUTH_USERNAME
                string "Set username for authentication"
                default "espressif"
                depends on !EXAMPLE_MODEM_PPP_AUTH_NONE
                help
                    Set username for PPP Authentication.
        
            config EXAMPLE_MODEM_PPP_AUTH_PASSWORD
                string "Set password for authentication"
                default "esp32"
                depends on !EXAMPLE_MODEM_PPP_AUTH_NONE
                help
                    Set password for PPP Authentication.
        
            config EXAMPLE_MODEM_PPP_AUTH_NONE
                bool "Skip PPP authentication"
                default n
                help
                    Set to true for the PPP client to skip authentication
        
            config EXAMPLE_SEND_MSG
                bool "Short message (SMS)"
                default n
                help
                    Select this, the modem will send a short message before power off.
        
            if EXAMPLE_SEND_MSG
                config EXAMPLE_SEND_MSG_PEER_PHONE_NUMBER
                    string "Peer Phone Number (with area code)"
                    default "+8610086"
                    help
                        Enter the peer phone number that you want to send message to.
            endif
        
            config EXAMPLE_UART_ISR_IN_RAM
                bool "Use UART ISR in RAM"
                default n
                select UART_ISR_IN_IRAM
                help
                    Enable placing UART ISR to IRAM.
                    This options is useful if PPPoS client needs to perform
                    flash operations (e.g. OTA) while keeping the network operational.
        
            config EXAMPLE_LCP_ECHO
                bool "Enable LCP ECHO"
                default n
                select LWIP_ENABLE_LCP_ECHO
                help
                    Enable this option to make use of LCP keepalive using
                    LCP_ECHO_INTERVAL and LCP_MAXECHOFAILS to default values
        
            menu "UART Configuration"
                config EXAMPLE_MODEM_UART_TX_PIN
                    int "TXD Pin Number"
                    default 25
                    range 0 31
                    help
                        Pin number of UART TX.
        
                config EXAMPLE_MODEM_UART_RX_PIN
                    int "RXD Pin Number"
                    default 26
                    range 0 31
                    help
                        Pin number of UART RX.
        
                config EXAMPLE_MODEM_UART_RTS_PIN
                    int "RTS Pin Number"
                    default 27
                    range 0 31
                    help
                        Pin number of UART RTS.
        
                config EXAMPLE_MODEM_UART_CTS_PIN
                    int "CTS Pin Number"
                    default 23
                    range 0 31
                    help
                        Pin number of UART CTS.
        
                config EXAMPLE_MODEM_UART_EVENT_TASK_STACK_SIZE
                    int "UART Event Task Stack Size"
                    range 2000 6000
                    default 3072
                    help
                        Stack size of UART event task.
        
                config EXAMPLE_MODEM_UART_EVENT_TASK_PRIORITY
                    int "UART Event Task Priority"
                    range 3 22
                    default 5
                    help
                        Priority of UART event task.
        
                config EXAMPLE_MODEM_UART_EVENT_QUEUE_SIZE
                    int "UART Event Queue Size"
                    range 10 40
                    default 30
                    help
                        Length of UART event queue.
        
                config EXAMPLE_MODEM_UART_TX_BUFFER_SIZE
                    int "UART TX Buffer Size"
                    range 256 2048
                    default 512
                    help
                        Buffer size of UART TX buffer.
        
                config EXAMPLE_MODEM_UART_RX_BUFFER_SIZE
                    int "UART RX Buffer Size"
                    range 256 2048
                    default 1024
                    help
                        Buffer size of UART RX buffer.
            endmenu
        
        endmenu
        
    endmenu
```
